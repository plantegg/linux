## net/ipv4/tcp_rt/Kconfig
```kconfig
config TCP_RT_MODE
	tristate "TcpRt module"
	default m
	depends on TCP_RT
	help
	  This module depends on TcpRt framework, collect the request
	  information on tcp and output by relay.
```
